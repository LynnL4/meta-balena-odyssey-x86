## conf/layer.conf
```bitbake
# We have a conf and classes directory, add to BBPATH
BBPATH .= ":${LAYERDIR}"

# We have a recipes-* directories, add to BBFILES
BBFILES += "${LAYERDIR}/recipes-*/*/*.bb \
	${LAYERDIR}/recipes-*/*/*.bbappend"

BBFILE_COLLECTIONS += "balena-odyssey-x86"
BBFILE_PATTERN_balena-odyssey-x86 := "^${LAYERDIR}/"
BBFILE_PRIORITY_balena-odyssey-x86 = "6"

LAYERSERIES_COMPAT_balena-odyssey-x86 = "dunfell"
```

## conf/machine/odyssey-x86.conf
```bitbake
#@TYPE: Machine
##@NAME: odyssey
##@DESCRIPTION: Machine configuration for Seeed Odyssey X86

MACHINEOVERRIDES = "genericx86-64:${MACHINE}"
include conf/machine/genericx86-64.conf

ACPI_TABLES ?= "spidev1.0.asl spidev1.1.asl"

FIRMWARE_COMPRESSION ?= "1"
```
